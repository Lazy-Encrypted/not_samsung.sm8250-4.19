## block/uxio_first/Kconfig
```kconfig
# SPDX-License-Identifier: GPL-2.0-only
# Copyright (C) 2018-2020 Oplus. All rights reserved.

config OPLUS_FEATURE_UXIO_FIRST
	bool "Support for ux io first opt"
	default y
	help
	  Enable UX IO first optimization. Prioritizes UI and foreground
	  I/O requests over background requests in block layer.
```
